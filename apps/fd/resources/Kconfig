## apps/fd/resources/Kconfig
```kconfig
# Copyright (c) 2023 Anhui Listenai Co., Ltd.
# SPDX-License-Identifier: Apache-2.0

config APLICATION_PACK_IMAGES
	bool "Package all algorithm resources, CP firmware and AP firmware into one image file"
	default y

rsource "Kconfig.images"
```

## apps/fd/resources/Kconfig.images
```kconfig
# SPDX-License-Identifier: Apache-2.0

DT_CHOSEN_RES_CP := resource,cp

config FLASH_RES_CP_ADDR
	def_hex $(dt_chosen_reg_addr_hex,$(DT_CHOSEN_RES_CP))

config FLASH_RES_CP_SIZE
	def_int $(dt_chosen_reg_size_int,$(DT_CHOSEN_RES_CP))

if CAPABILITY_FD
DT_CHOSEN_RES_FD_FACE_DETECT := resource,fd_face_detect

config FLASH_RES_FD_FACE_DETECT_ADDR
	def_hex $(dt_chosen_reg_addr_hex,$(DT_CHOSEN_RES_FD_FACE_DETECT))

config FLASH_RES_FD_FACE_DETECT_SIZE
	def_int $(dt_chosen_reg_size_int,$(DT_CHOSEN_RES_FD_FACE_DETECT))

DT_CHOSEN_RES_FD_FACE_ALIGN := resource,fd_face_align

config FLASH_RES_FD_FACE_ALIGN_ADDR
	def_hex $(dt_chosen_reg_addr_hex,$(DT_CHOSEN_RES_FD_FACE_ALIGN))

config FLASH_RES_FD_FACE_ALIGN_SIZE
	def_int $(dt_chosen_reg_size_int,$(DT_CHOSEN_RES_FD_FACE_ALIGN))

DT_CHOSEN_RES_FD_FACE_VERIFY := resource,fd_face_verify

config FLASH_RES_FD_FACE_VERIFY_ADDR
	def_hex $(dt_chosen_reg_addr_hex,$(DT_CHOSEN_RES_FD_FACE_VERIFY))

config FLASH_RES_FD_FACE_VERIFY_SIZE
	def_int $(dt_chosen_reg_size_int,$(DT_CHOSEN_RES_FD_FACE_VERIFY))

DT_CHOSEN_RES_FD_ANTI_SPOOFING := resource,fd_anti_spoofing

config FLASH_RES_FD_ANTI_SPOOFING_ADDR
	def_hex $(dt_chosen_reg_addr_hex,$(DT_CHOSEN_RES_FD_ANTI_SPOOFING))

config FLASH_RES_FD_ANTI_SPOOFING_SIZE
	def_int $(dt_chosen_reg_size_int,$(DT_CHOSEN_RES_FD_ANTI_SPOOFING))

DT_CHOSEN_RES_FD_FACE_DEPTH := resource,fd_face_depth

config FLASH_RES_FD_FACE_DEPTH_ADDR
	def_hex $(dt_chosen_reg_addr_hex,$(DT_CHOSEN_RES_FD_FACE_DEPTH))

config FLASH_RES_FD_FACE_DEPTH_SIZE
	def_int $(dt_chosen_reg_size_int,$(DT_CHOSEN_RES_FD_FACE_DEPTH))

DT_CHOSEN_RES_FD_ANTI_BILINEAR := resource,fd_anti_bilinear

config FLASH_RES_FD_ANTI_BILINEAR_ADDR
	def_hex $(dt_chosen_reg_addr_hex,$(DT_CHOSEN_RES_FD_ANTI_BILINEAR))

config FLASH_RES_FD_ANTI_BILINEAR_SIZE
	def_int $(dt_chosen_reg_size_int,$(DT_CHOSEN_RES_FD_ANTI_BILINEAR))

endif # CAPABILITY_FD
```

## boards/arm/moss/Kconfig.board
```kconfig
# SPDX-License-Identifier: Apache-2.0

config BOARD_MOSS
   bool "Moss board"
   depends on SOC_CSK6
```

## boards/arm/moss/Kconfig.defconfig
```kconfig
if BOARD_MOSS

# Always set CONFIG_BOARD here. This isn't meant to be customized,
# but is set as a "default" due to Kconfig language restrictions.
config BOARD
   default "moss"

# Other options you want enabled by default go next.

DT_CHOSEN_Z_PSRAM := zephyr,psram

config PSRAM_SIZE
	hex
	default "$(dt_chosen_reg_size_hex,$(DT_CHOSEN_Z_PSRAM))"

endif # BOARD_MOSS
```

## drivers/Kconfig
```kconfig
#
# Copyright (c) 2023 listenai Intelligent Technology (anhui) Co., Ltd.
#
# SPDX-License-Identifier: Apache-2.0
#

menu "Moss Device Drivers"

rsource "display/Kconfig"

endmenu
```

## drivers/display/Kconfig.st7789v_moss
```kconfig
# ST7789V display driver configuration options

# Copyright (c) 2019 Marc Reilly <marc@cpdesign.com.au>
# SPDX-License-Identifier: Apache-2.0

menuconfig ST7789V_MOSS
	bool "ST7789V display driver"
	depends on SPI
	select MUTEX
	select DISPLAY_CSK6_LCD
	help
	  Enable driver for ST7789V display driver.

config ST7789V_MOSS_DMA_CHANNEL
	int "ST7789V_MOSS_DMA_CHANNEL"
	default 0

config ST7789V_MOSS_ROTATE_90
	bool "ST7789V_MOSS_ROTATE_90"
	default n

choice ST7789V_PIXEL_FORMAT
	prompt "Color pixel format"
	default ST7789V_RGB565
	depends on ST7789V_MOSS
	help
	  Specify the color pixel format for the ST7789V display controller.

config ST7789V_RGB565
	bool "RGB565"

endchoice
```

## west.yml
```yaml
manifest:
  remotes:
    - name: duomotai
      url-base: https://cloud.listenai.com/CSKG962172
  projects:
    - name: duomotai_ap
      remote: duomotai
      revision: v1.10.0
      import:
        name-allowlist:
          - csk
          - zephyr
          - cmsis # required by the ARM port
          - mbedtls
          - csk6_cm33
          - protobuf-c
          - esp-hosted
          - littlefs
          - fatfs
          - lsf-for-zephyr
          - lsf
          - urpc
          - lvgl
          - freertos_shims
```
